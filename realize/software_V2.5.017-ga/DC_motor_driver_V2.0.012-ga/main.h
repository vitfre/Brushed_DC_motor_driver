/*
 * main.h
 *
 * Created: 11.02.2014 17:51:42
 *  Author: Администратор
 */ 



#ifndef LD_H_
#define LD_H_
//---------------------------------------------------------------------------------------
#define F_CPU 16000000UL // or whatever may be your frequency
//---------------------------------------------------------------------------------------
#include <avr/interrupt.h>
#include <avr/pgmspace.h>
#include <util/delay.h>
#include <avr/eeprom.h>
#include <avr/io.h>
//---------------------------------------------------------------------------------------
#include "usart_debug/buart.h"
#include "init_mcu.h"
#include "buttons.h"
#include "song.h"
#include "seg_7.h"
#include "meas.h"
//---------------------------------------------------------------------------------------
#define	min_power		0x88
//---------------------------------------------------------------------------------------
#define START_WORK_1 	FLAGS.SETT_WORK_1=0x01;																						(PORTD&=~(1<<7));	(PORTD&=~(1<<6));
#define STOP_WORK_1 	(PORTD&=~(1<<4));	TCCR2=0x00;			TCNT2=min_power;	power=min_power;	FLAGS.SETT_WORK_1=0x00;		(PORTD|=(1<<7));	(PORTD|=(1<<6));//
//---------------------------------------------------------------------------------------
#define START_WORK_2	FLAGS.SETT_WORK_2=0x01;	 (PORTA&=~(1<<3));	FLAGS.HOLD_M_4=0x02;	(PORTD|=(1<<7));	TK_2=0x0000;
#define STOP_WORK_2		FLAGS.SETT_WORK_2=0x00;	 (PORTA|=(1<<3));	(PORTA|=(1<<4));	FLAGS.HOLD_M_4=0x00;
//---------------------------------------------------------------------------------------
#define IMP_SEM_SET_M1 	(PORTD|=(1<<4));	TCCR2=0x00;			TCNT2=min_power;	//  T2
#define IMP_SEM_CLR_M1 	(PORTD&=~(1<<4));	TCCR2=0x07;			TCNT2=power;		// старт T2
//---------------------------------------------------------------------------------------
// Підключаю глобальні змінні
unsigned int RP = 0;
unsigned int RPS = 0;	//Оберти двигуна
//---------------------------------------------------------------------------------------
unsigned int duty_cycle = 0;	//
//---------------------------------------------------------------------------------------
unsigned int set_time=0x00, time_old=0x00, timer=0x00, time_diff=0x00;
unsigned char set_speed=0x00, speed_old=0x00, set_max_speed=0x00, power=min_power, power_dif=0x00;
unsigned char moderator=0x00;
unsigned char TK_1=0x00;
unsigned int TK_2=0x00;
//---------------------------------------------------------------------------------------
unsigned char tic=0;
//---------------------------------------------------------------------------------------
struct {unsigned SETT_WORK_1 : 1;                    // Максимальне значення вих. напруги
		unsigned SETT_WORK_2 : 1;
		unsigned HOLD_SPED : 2;
		unsigned HOLD_TIME : 2;
		unsigned HOLD_M_4 : 2;
		unsigned POWER_SETT : 3;} FLAGS;   // Старші біти діапазона кутів
//---------------------------------------------------------------------------------------
/*
void(* resetFunc) (void) = 0; // Reset MC function
//---------------------------------------------------------------------------------------
void Func_reset(void)
{
	// Watchdog Timer initialization
	// Watchdog Timer Prescaler: OSC/16k
	WDTCR=0x08;
	while (1)
	{
	};
};
*/
//---------------------------------------------------------------------------------------
void func_meas_vars(void)
{
	//---------------------------------------------------------------------------------------
	unsigned int meas_time=0x00;
	unsigned char meas_speed=0x00;
	//---------------------------------------------------------------------------------------
	meas_speed=(read_adc(0)/4);
	if (meas_speed<26)
	{
		meas_speed=26;
	} 
	else
	{
		//---------------------------------------------------------------------------------------
		if (meas_speed>set_max_speed)
		{
			meas_speed=set_max_speed;
		}
		else
		{
		};
		//---------------------------------------------------------------------------------------
	};
	//---------------------------------------------------------------------------------------
	meas_time=read_adc(1);
	if (meas_time<15)
	{
		meas_time=15;
	} 
	else
	{
		//---------------------------------------------------------------------------------------
		if (meas_time>999)
		{
			meas_time=999;
		}
		else
		{
		};
		//---------------------------------------------------------------------------------------
	};
	//---------------------------------------------------------------------------------------
	if (((set_speed+2)<=meas_speed)||((set_speed-2)>=meas_speed))
	{
		//---------------------------------------------------------------------------------------
		set_speed=meas_speed;
		//---------------------------------------------------------------------------------------
	}
	else
	{
		//---------------------------------------------------------------------------------------
		
		//---------------------------------------------------------------------------------------
	};
	//---------------------------------------------------------------------------------------
	if (((set_time+10)<=meas_time)||((set_time-10)>=meas_time))
	{
		//---------------------------------------------------------------------------------------
		set_time=meas_time;
		//---------------------------------------------------------------------------------------
	}
	else
	{
		//---------------------------------------------------------------------------------------
		
		//---------------------------------------------------------------------------------------
	};
	//---------------------------------------------------------------------------------------
};
//---------------------------------------------------------------------------------------
void func_reg_power(void)
{
	//---------------------------------------------------------------------------------------
	if ((time_diff!=0x00)&&(FLAGS.SETT_WORK_1!=0x00))
	{
		//---------------------------------------------------------------------------------------
		if (RPS==0)
		{
			//---------------------------------------------------------------------------------------
			power=(min_power+set_speed/2.24)-moderator;
			//---------------------------------------------------------------------------------------
		} 
		else
		{
			//---------------------------------------------------------------------------------------
			FLAGS.POWER_SETT=0x02;
			if ((set_speed-3)<RPS)
			{
				//---------------------------------------------------------------------------------------
				if (power_dif>1)
				{
					//---------------------------------------------------------------------------------------
					power_dif--;
					FLAGS.POWER_SETT=0x03;
					//---------------------------------------------------------------------------------------
				}
				else
				{
					//---------------------------------------------------------------------------------------
					
					//---------------------------------------------------------------------------------------
				};
				//---------------------------------------------------------------------------------------
			};
			//---------------------------------------------------------------------------------------
			if ((set_speed+3)>RPS)
			{
				//---------------------------------------------------------------------------------------
				if (power_dif<51)
				{
					//---------------------------------------------------------------------------------------
					power_dif++;
					FLAGS.POWER_SETT=0x04;
					//---------------------------------------------------------------------------------------
				}
				else
				{
					//---------------------------------------------------------------------------------------
					
					//---------------------------------------------------------------------------------------
				};
				//---------------------------------------------------------------------------------------
			};
			//---------------------------------------------------------------------------------------
			power=(min_power+set_speed/4+power_dif)-moderator;
			//---------------------------------------------------------------------------------------
		};
		//---------------------------------------------------------------------------------------
		/*
		if (TK==0x10)
		{
			uart_write(0x01);
			uart_write(set_speed);
			uart_write(0x02);
			uart_write(RPS);
		} 
		else
		{
		};
		*/
		//---------------------------------------------------------------------------------------
		//---------------------------------------------------------------------------------------
	}
	else
	{
		//---------------------------------------------------------------------------------------
		
		//---------------------------------------------------------------------------------------
	};
	//---------------------------------------------------------------------------------------
};
//---------------------------------------------------------------------------------------
void func_sel_rejim(void)
{
	//---------------------------------------------------------------------------------------
	switch (BUT_GetKey())		// Читаємо буфер клавіатури і переходим на відповідний case в залежності від коду кнопки
	{
		case 0x00 :
		{
			//---------------------------------------------------------------------------------------
			if (moderator!=0x00)
			{
				//---------------------------------------------------------------------------------------
				moderator--;
				//---------------------------------------------------------------------------------------
			};
			//---------------------------------------------------------------------------------------
		};
		break;
		case 0x01 :
		{
			//---------------------------------------------------------------------------------------
			if (FLAGS.SETT_WORK_1==0x01)
			{
				//---------------------------------------------------------------------------------------
				beep_tone(10);
				STOP_WORK_1
				moderator=0x00;
				//---------------------------------------------------------------------------------------
			}
			else
			{
				//---------------------------------------------------------------------------------------
				beep_tone(10);
				START_WORK_1
				moderator=set_speed/4;
				//---------------------------------------------------------------------------------------
			};
			//---------------------------------------------------------------------------------------
		};
		break;
		case 0x02 :
		{
			//---------------------------------------------------------------------------------------
			if (FLAGS.SETT_WORK_2==0x01)
			{
				//---------------------------------------------------------------------------------------
				beep_tone(10);
				STOP_WORK_2
				duty_cycle++;
				eeprom_write_word((uint16_t*)0x10,(uint16_t)duty_cycle);
				//---------------------------------------------------------------------------------------
			}
			else
			{
				//---------------------------------------------------------------------------------------
				while ( ( (((PINA)>>(2))&1)==0x00 )&&(tic<150) )
				{
					_delay_ms(10);
					tic++;
				};
				//---------------------------------------------------------------------------------------
				if ( (FLAGS.SETT_WORK_1==0x01)&&( tic==150 ) )
				{
					//---------------------------------------------------------------------------------------
					beep_tone(2000);
					if ((((PINA)>>(5))&1)==0x00)
					{
						//---------------------------------------------------------------------------------------
						set_max_speed = set_speed;
						eeprom_write_byte((uint8_t*)0x00,(uint8_t)set_max_speed);
						//---------------------------------------------------------------------------------------
					}
					else
					{
					};
					//---------------------------------------------------------------------------------------
				} 
				else if ( (FLAGS.SETT_WORK_1==0x00)&&( tic==150 ) )
				{
					//---------------------------------------------------------------------------------------
					FLAGS.POWER_SETT=0x05;
					//---------------------------------------------------------------------------------------
					Set_led_num(duty_cycle);
					beep_tone(2000);
					while ( (((PINA)>>(2))&1)==0x00 )
					{
						_delay_ms(20);
					};
					if ((((PINA)>>(5))&1)==0x00)
					{
						//---------------------------------------------------------------------------------------
						eeprom_write_word((uint16_t*)0x10,(uint16_t)duty_cycle);
						//---------------------------------------------------------------------------------------
					}
					else
					{
					};
					//---------------------------------------------------------------------------------------
					FLAGS.POWER_SETT=0x00;
					//---------------------------------------------------------------------------------------
				}
				else
				{
					//---------------------------------------------------------------------------------------
					beep_tone(10);
					duty_cycle = eeprom_read_word((uint16_t*)(0x10));
					START_WORK_2
					//---------------------------------------------------------------------------------------
				};
				//---------------------------------------------------------------------------------------
				tic=0;
				//---------------------------------------------------------------------------------------	
			};
			//---------------------------------------------------------------------------------------
		};
		break;
		default :;
	};   //switch (BUT_GetKey())
	//---------------------------------------------------------------------------------------
};
//---------------------------------------------------------------------------------------
void func_timer(void)
{
	//---------------------------------------------------------------------------------------
	if (TK_1==0x10)
	{
		TK_1=0x00;
		//---------------------------------------------------------------------------------------
		if (FLAGS.SETT_WORK_1!=0x00)
		{
			//---------------------------------------------------------------------------------------
			timer++;
			if (timer>=set_time)
			{
				//---------------------------------------------------------------------------------------
				timer=set_time;
				STOP_WORK_1
				//---------------------------------------------------------------------------------------
			}
			else
			{
				//---------------------------------------------------------------------------------------
				
				//---------------------------------------------------------------------------------------
			};
			time_diff=set_time-timer;
			//---------------------------------------------------------------------------------------
			if ((FLAGS.HOLD_SPED==0x00)&&(FLAGS.HOLD_TIME==0x00))
			{
				Set_led_num(time_diff);
			} 
			else if (FLAGS.HOLD_SPED!=0x00)
			{
				FLAGS.HOLD_SPED--;
			}
			else if (FLAGS.HOLD_TIME!=0x00)
			{
				FLAGS.HOLD_TIME--;
			};
			//---------------------------------------------------------------------------------------
			//uart_write(0x03);
			//uart_write(power);
			//---------------------------------------------------------------------------------------
		}
		else
		{
			//---------------------------------------------------------------------------------------
			timer=0x00;
			//---------------------------------------------------------------------------------------
		};
		//---------------------------------------------------------------------------------------
		if (FLAGS.SETT_WORK_2==0x01)
		{
			if (FLAGS.HOLD_M_4==0x00)
			{
				(PORTA&=~(1<<4));
			}
			else
			{
				FLAGS.HOLD_M_4--;
			};
			//---------------------------------------------------------------------------------------
			
			//---------------------------------------------------------------------------------------			
		} 
		else
		{
			
		};		
		//---------------------------------------------------------------------------------------
	} 
	else
	{
		TK_1++;
	};
	//---------------------------------------------------------------------------------------
};
//---------------------------------------------------------------------------------------
void func_show_vars(void)
{
	//---------------------------------------------------------------------------------------
	if (speed_old!=set_speed)
	{
		//---------------------------------------------------------------------------------------
		Set_led_num(set_speed/2.55);
		speed_old=set_speed;
		FLAGS.HOLD_SPED=2;
		//---------------------------------------------------------------------------------------
	}
	else
	{
		//---------------------------------------------------------------------------------------
		if (time_old!=set_time)
		{
			//---------------------------------------------------------------------------------------
			Set_led_num(set_time);
			time_old=set_time;
			FLAGS.HOLD_TIME=2;
			//---------------------------------------------------------------------------------------
		}
		else
		{
			//---------------------------------------------------------------------------------------
			
			//---------------------------------------------------------------------------------------
		};
		//---------------------------------------------------------------------------------------
	};
	//---------------------------------------------------------------------------------------
};
//---------------------------------------------------------------------------------------
#endif /* LD_H_ */